## ch2/Kconfig.patch
```kconfig
--- /home/llkd/linux-5.4/init/Kconfig.orig	2020-01-17 10:10:16.311175708 +0530
+++ /home/llkd/linux-5.4/init/Kconfig	2020-01-17 10:10:19.399208226 +0530
@@ -165,6 +165,20 @@
 
 	  which is done within the script "scripts/setlocalversion".)
 
+config LLKD_OPTION1
+       bool "Test case for LLKD book/Ch 2: creating a new menu item in kernel config"
+       default n
+       help
+          This option is merely a dummy 'test'; it's simply to have readers of our book
+          - 'Linux Kernel Programming', Kaiwan NB, Packt - try out the creation of
+          a few menu items within the kernel config.
+
+          Try setting this option to 'Y' (true), save and exit, and see the effect this
+          has by doing:
+           grep "CONFIG_LLKD_OPTION1" .config
+
+          If unsure, say N
+
 config BUILD_SALT
        string "Build ID Salt"
        default ""
```
